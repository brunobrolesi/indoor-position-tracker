## anchor/firmware/sdkconfig.defaults
```kconfig
# Bluetooth — NimBLE only
CONFIG_BT_ENABLED=y
CONFIG_BT_NIMBLE_ENABLED=y
CONFIG_BT_BLUEDROID_ENABLED=n
CONFIG_BT_CONTROLLER_ENABLED=y
CONFIG_BT_CLASSIC_ENABLED=n

# NimBLE passive scan for BLE 5 Coded PHY extended advertising
CONFIG_BT_NIMBLE_EXT_ADV=y
CONFIG_BT_NIMBLE_MAX_EXT_ADV_INSTANCES=1
CONFIG_BT_NIMBLE_EXT_ADV_MAX_SIZE=31
CONFIG_BT_NIMBLE_MSYS_1_BLOCK_COUNT=12
CONFIG_BT_NIMBLE_HOST_TASK_STACK_SIZE=4096

# WiFi + BLE coexistence (validated in T0 spike)
CONFIG_ESP_COEX_ENABLED=y
CONFIG_ESP_COEX_SW_COEXIST_ENABLE=y

# WiFi
CONFIG_ESP_WIFI_ENABLED=y
CONFIG_ESP_WIFI_STATIC_RX_BUFFER_NUM=10
CONFIG_ESP_WIFI_DYNAMIC_RX_BUFFER_NUM=32

# SNTP
CONFIG_LWIP_DHCP_GET_NTP_SRV=y

# NVS
CONFIG_NVS_ENCRYPTION=n

# Flash
CONFIG_ESPTOOLPY_FLASHSIZE_4MB=y
CONFIG_ESPTOOLPY_FLASHSIZE="4MB"
CONFIG_PARTITION_TABLE_SINGLE_APP_LARGE=y

# Task watchdog
CONFIG_ESP_TASK_WDT_INIT=y
CONFIG_ESP_TASK_WDT_PANIC=y

# Log
CONFIG_LOG_DEFAULT_LEVEL_INFO=y
```

## tag/firmware/sdkconfig.defaults
```kconfig
# Bluetooth — NimBLE only, Bluedroid disabled
CONFIG_IDF_TARGET="esp32s3"
CONFIG_BT_ENABLED=y
CONFIG_BT_NIMBLE_ENABLED=y
CONFIG_BT_BLUEDROID_ENABLED=n
CONFIG_BT_CONTROLLER_ENABLED=y

# NimBLE Extended Advertising (required — not enabled by default in IDF v6.0)
CONFIG_BT_NIMBLE_EXT_ADV=y
CONFIG_BT_NIMBLE_MAX_EXT_ADV_INSTANCES=1
CONFIG_BT_NIMBLE_EXT_ADV_MAX_SIZE=31
CONFIG_BT_NIMBLE_MSYS_1_BLOCK_COUNT=12
CONFIG_BT_NIMBLE_HOST_TASK_STACK_SIZE=4096

# Classic BT disabled
CONFIG_BT_CLASSIC_ENABLED=n

# NVS
CONFIG_NVS_ENCRYPTION=n

# Flash size
CONFIG_ESPTOOLPY_FLASHSIZE_4MB=y
CONFIG_ESPTOOLPY_FLASHSIZE="4MB"

# Task watchdog
CONFIG_ESP_TASK_WDT_INIT=y
CONFIG_ESP_TASK_WDT_PANIC=y

# Log level
CONFIG_LOG_DEFAULT_LEVEL_INFO=y
```
